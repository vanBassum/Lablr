## lablr-bridge/sdkconfig.defaults
```kconfig
# Partition table
CONFIG_PARTITION_TABLE_CUSTOM=y
CONFIG_PARTITION_TABLE_CUSTOM_FILENAME="partitions.csv"

# Flash size and speed (ESP32-S3-WROOM-1 N16R8 = 16 MB flash)
CONFIG_ESPTOOLPY_FLASHSIZE_16MB=y
CONFIG_ESPTOOLPY_FLASHFREQ_80M=y

# ── PSRAM (N16R8 = 8 MB OCTAL SPIRAM) ──────────────────────────
# Without this, WiFi + NimBLE + USB host + mbedTLS exhaust internal RAM:
# TLS setup, the HTTP server task, and USB EP alloc all fail with NO_MEM.
# Routing WiFi/LWIP + large (TLS) allocations to PSRAM frees internal RAM.
CONFIG_SPIRAM=y
CONFIG_SPIRAM_MODE_OCT=y
CONFIG_SPIRAM_SPEED_80M=y
CONFIG_SPIRAM_USE_MALLOC=y
CONFIG_SPIRAM_TRY_ALLOCATE_WIFI_LWIP=y
# Allocations larger than this go to PSRAM; smaller stay internal.
CONFIG_SPIRAM_MALLOC_ALWAYSINTERNAL=8192
# Let mbedTLS pull its big buffers from PSRAM-capable heap.
CONFIG_MBEDTLS_EXTERNAL_MEM_ALLOC=y

# HTTP server WebSocket support
CONFIG_HTTPD_WS_SUPPORT=y

# Increase timer task stack (default 2048 too small for WiFi calls in timer callbacks)
CONFIG_FREERTOS_TIMER_TASK_STACK_DEPTH=4096

# FAT long filename support (needed for React build output)
CONFIG_FATFS_LFN_HEAP=y
CONFIG_FATFS_MAX_LFN=255

# ── Bluetooth LE (NimBLE host) — phone <-> bridge ──────────────
CONFIG_BT_ENABLED=y
CONFIG_BT_NIMBLE_ENABLED=y
# Peripheral only: we advertise and accept connections, we never scan/connect.
CONFIG_BT_NIMBLE_ROLE_PERIPHERAL=y
CONFIG_BT_NIMBLE_ROLE_BROADCASTER=y
CONFIG_BT_NIMBLE_ROLE_CENTRAL=n
CONFIG_BT_NIMBLE_ROLE_OBSERVER=n

# ── USB OTG in HOST mode — bridge <-> Dymo ─────────────────────
# The espressif/usb component (idf_component.yml) provides the host library.
# Enumeration timing: the stock 30ms reset-hold/recovery is too short for some
# self-powered devices (the Dymo failed CHECK_SHORT_DEV_DESC on the first EP0
# transfer). Give the printer more time to be ready after bus reset.
CONFIG_USB_HOST_DEBOUNCE_DELAY_MS=500
CONFIG_USB_HOST_RESET_HOLD_MS=100
CONFIG_USB_HOST_RESET_RECOVERY_MS=100
CONFIG_USB_HOST_SET_ADDR_RECOVERY_MS=20

# OTA rollback — pairs with esp_ota_mark_app_valid_cancel_rollback() in main.cpp
CONFIG_BOOTLOADER_APP_ROLLBACK_ENABLE=y
```
